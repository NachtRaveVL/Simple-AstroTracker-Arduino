/*  Astruino enum decoding tree.
    Generated by tests/generate_enum_trie.py. Do not hand edit.
*/

#ifndef AstroEnumTrie_H
#define AstroEnumTrie_H

#include "AstroDefines.h"

inline Astro_SystemMode astroDecodeSystemMode(const AstroString &systemModeStr)
{
    switch (systemModeStr.length() > 0 ? systemModeStr[0] : '\0') {
        case 'B':
            return Astro_SystemMode_Balancing;
        case 'C':
            return Astro_SystemMode_Count;
        case 'M':
            return Astro_SystemMode_Manual;
        case 'T':
            return Astro_SystemMode_Tracking;
        case 'U':
            return Astro_SystemMode_Undefined;
    }
    return Astro_SystemMode_Undefined;
}

inline Astro_MeasurementMode astroDecodeMeasurementMode(const AstroString &measurementModeStr)
{
    switch (measurementModeStr.length() > 0 ? measurementModeStr[0] : '\0') {
        case 'C':
            return Astro_MeasurementMode_Count;
        case 'I':
            return Astro_MeasurementMode_Imperial;
        case 'M':
            return Astro_MeasurementMode_Metric;
        case 'S':
            return Astro_MeasurementMode_Scientific;
        case 'U':
            return Astro_MeasurementMode_Undefined;
    }
    return Astro_MeasurementMode_Undefined;
}

inline Astro_ActuatorType astroDecodeActuatorType(const AstroString &actuatorTypeStr)
{
    switch (actuatorTypeStr.length() > 6 ? actuatorTypeStr[6] : '\0') {
        case '\0':
            switch (actuatorTypeStr.length() > 2 ? actuatorTypeStr[2] : '\0') {
                case 'n':
                    return Astro_ActuatorType_Fan;
                case 'u':
                    return Astro_ActuatorType_Count;
                case 'v':
                    return Astro_ActuatorType_Cover;
            }
            return Astro_ActuatorType_Undefined;
        case 'C':
            return Astro_ActuatorType_CameraCooler;
        case 'c':
            return Astro_ActuatorType_Generic;
        case 'n':
            return Astro_ActuatorType_Undefined;
        case 'r':
            return Astro_ActuatorType_Focuser;
        case 't':
            return Astro_ActuatorType_DewHeater;
        case 'x':
            return Astro_ActuatorType_MountAxis;
    }
    return Astro_ActuatorType_Undefined;
}

inline Astro_SensorType astroDecodeSensorType(const AstroString &sensorTypeStr)
{
    switch (sensorTypeStr.length() > 0 ? sensorTypeStr[0] : '\0') {
        case 'C':
            switch (sensorTypeStr.length() > 1 ? sensorTypeStr[1] : '\0') {
                case 'a':
                    return Astro_SensorType_CameraTemperature;
                case 'o':
                    return Astro_SensorType_Count;
                case 'u':
                    return Astro_SensorType_Current;
            }
            return Astro_SensorType_Undefined;
        case 'G':
            return Astro_SensorType_Generic;
        case 'H':
            return Astro_SensorType_Humidity;
        case 'L':
            switch (sensorTypeStr.length() > 2 ? sensorTypeStr[2] : '\0') {
                case 'g':
                    return Astro_SensorType_Light;
                case 'm':
                    return Astro_SensorType_LimitSwitch;
            }
            return Astro_SensorType_Undefined;
        case 'P':
            return Astro_SensorType_Position;
        case 'R':
            return Astro_SensorType_Rain;
        case 'T':
            return Astro_SensorType_Temperature;
        case 'U':
            return Astro_SensorType_Undefined;
        case 'V':
            return Astro_SensorType_Voltage;
        case 'W':
            return Astro_SensorType_WindSpeed;
    }
    return Astro_SensorType_Undefined;
}

inline Astro_MountType astroDecodeMountType(const AstroString &mountTypeStr)
{
    switch (mountTypeStr.length() > 0 ? mountTypeStr[0] : '\0') {
        case 'A':
            return Astro_MountType_AltAz;
        case 'C':
            return Astro_MountType_Count;
        case 'E':
            return Astro_MountType_Equatorial;
        case 'S':
            return Astro_MountType_SingleAxis;
        case 'U':
            return Astro_MountType_Unknown;
    }
    return Astro_MountType_Unknown;
}

inline Astro_RailType astroDecodeRailType(const AstroString &railTypeStr)
{
    switch (railTypeStr.length() > 2 ? railTypeStr[2] : '\0') {
        case '1':
            return Astro_RailType_DC12V;
        case '2':
            return Astro_RailType_DC24V;
        case '3':
            return Astro_RailType_DC3V3;
        case '5':
            return Astro_RailType_DC5V;
        case 'd':
            return Astro_RailType_Undefined;
        case 'u':
            return Astro_RailType_Count;
    }
    return Astro_RailType_Undefined;
}

inline Astro_PinMode astroDecodePinMode(const AstroString &pinModeStr)
{
    switch (pinModeStr.length() > 16 ? pinModeStr[16] : '\0') {
        case '\0':
            switch (pinModeStr.length() > 7 ? pinModeStr[7] : '\0') {
                case '\0':
                    return Astro_PinMode_Count;
                case 'I':
                    return Astro_PinMode_Digital_Input;
                case 'O':
                    return Astro_PinMode_Digital_Output;
                case 'e':
                    return Astro_PinMode_Undefined;
                case 'n':
                    return Astro_PinMode_Analog_Input;
                case 'u':
                    return Astro_PinMode_Analog_Output;
            }
            return Astro_PinMode_Undefined;
        case 'D':
            return Astro_PinMode_Digital_Input_PullDown;
        case 'U':
            return Astro_PinMode_Digital_Input_PullUp;
        case 'h':
            return Astro_PinMode_Digital_Output_PushPull;
    }
    return Astro_PinMode_Undefined;
}

inline Astro_EnableMode astroDecodeEnableMode(const AstroString &enableModeStr)
{
    switch (enableModeStr.length() > 0 ? enableModeStr[0] : '\0') {
        case 'A':
            return Astro_EnableMode_Average;
        case 'C':
            return Astro_EnableMode_Count;
        case 'H':
            return Astro_EnableMode_Highest;
        case 'I':
            return Astro_EnableMode_InOrder;
        case 'L':
            return Astro_EnableMode_Lowest;
        case 'M':
            return Astro_EnableMode_Multiply;
        case 'R':
            return Astro_EnableMode_RevOrder;
        case 'U':
            return Astro_EnableMode_Undefined;
    }
    return Astro_EnableMode_Undefined;
}

inline Astro_UnitsCategory astroDecodeUnitsCategory(const AstroString &unitsCategoryStr)
{
    switch (unitsCategoryStr.length() > 0 ? unitsCategoryStr[0] : '\0') {
        case 'A':
            return Astro_UnitsCategory_Angle;
        case 'C':
            switch (unitsCategoryStr.length() > 1 ? unitsCategoryStr[1] : '\0') {
                case 'o':
                    return Astro_UnitsCategory_Count;
                case 'u':
                    return Astro_UnitsCategory_Current;
            }
            return Astro_UnitsCategory_Undefined;
        case 'D':
            return Astro_UnitsCategory_Distance;
        case 'H':
            return Astro_UnitsCategory_Humidity;
        case 'P':
            switch (unitsCategoryStr.length() > 1 ? unitsCategoryStr[1] : '\0') {
                case 'e':
                    return Astro_UnitsCategory_Percentile;
                case 'o':
                    return Astro_UnitsCategory_Power;
            }
            return Astro_UnitsCategory_Undefined;
        case 'R':
            return Astro_UnitsCategory_Raw;
        case 'S':
            return Astro_UnitsCategory_Speed;
        case 'T':
            return Astro_UnitsCategory_Temperature;
        case 'U':
            return Astro_UnitsCategory_Undefined;
        case 'V':
            return Astro_UnitsCategory_Voltage;
    }
    return Astro_UnitsCategory_Undefined;
}

inline Astro_UnitsType astroDecodeUnitsType(const AstroString &unitsSymbolStr)
{
    switch (unitsSymbolStr.length() > 1 ? unitsSymbolStr[1] : '\0') {
        case '\0':
            switch (unitsSymbolStr.length() > 0 ? unitsSymbolStr[0] : '\0') {
                case '%':
                    return Astro_UnitsType_Percentile_100;
                case '1':
                    return Astro_UnitsType_Raw_1;
                case 'A':
                    return Astro_UnitsType_Current_Amperage;
                case 'C':
                    return Astro_UnitsType_Temperature_Celsius;
                case 'F':
                    return Astro_UnitsType_Temperature_Fahrenheit;
                case 'K':
                    return Astro_UnitsType_Temperature_Kelvin;
                case 'V':
                    return Astro_UnitsType_Voltage_Volts;
                case 'W':
                    return Astro_UnitsType_Power_Wattage;
                case 'm':
                    return Astro_UnitsType_Distance_Meters;
            }
            return Astro_UnitsType_Undefined;
        case '/':
            switch (unitsSymbolStr.length() > 0 ? unitsSymbolStr[0] : '\0') {
                case 'J':
                    return Astro_UnitsType_Power_Wattage;
                case 'm':
                    return Astro_UnitsType_Speed_MetersPerSec;
            }
            return Astro_UnitsType_Undefined;
        case 'R':
            return Astro_UnitsType_Humidity_RH;
        case 'a':
            return Astro_UnitsType_Angle_Radians_2pi;
        case 'e':
            return Astro_UnitsType_Angle_Degrees_360;
        case 'n':
            return Astro_UnitsType_Undefined;
        case 'o':
            return Astro_UnitsType_Count;
        case 't':
            switch (unitsSymbolStr.length() > 2 ? unitsSymbolStr[2] : '\0') {
                case '\0':
                    return Astro_UnitsType_Distance_Feet;
                case '/':
                    return Astro_UnitsType_Speed_FeetPerSec;
            }
            return Astro_UnitsType_Undefined;
    }
    return Astro_UnitsType_Undefined;
}

inline Astro_TargetClass astroDecodeTargetClass(const AstroString &targetClassStr)
{
    switch (targetClassStr.length() > 4 ? targetClassStr[4] : '\0') {
        case '\0':
            return Astro_TargetClass_Star;
        case 'C':
            return Astro_TargetClass_OpenCluster;
        case 'e':
            return Astro_TargetClass_PlanetaryNebula;
        case 'f':
            return Astro_TargetClass_Unknown;
        case 'l':
            return Astro_TargetClass_Nebula;
        case 'r':
            switch (targetClassStr.length() > 0 ? targetClassStr[0] : '\0') {
                case 'O':
                    return Astro_TargetClass_Other;
                case 'S':
                    return Astro_TargetClass_SolarSystem;
            }
            return Astro_TargetClass_Unknown;
        case 't':
            return Astro_TargetClass_Count;
        case 'u':
            return Astro_TargetClass_GlobularCluster;
        case 'x':
            return Astro_TargetClass_Galaxy;
    }
    return Astro_TargetClass_Unknown;
}

inline Astro_ThermalMode astroDecodeThermalMode(const AstroString &thermalModeStr)
{
    switch (thermalModeStr.length() > 0 ? thermalModeStr[0] : '\0') {
        case 'C':
            return Astro_ThermalMode_Count;
        case 'D':
            return Astro_ThermalMode_DayStorage;
        case 'N':
            return Astro_ThermalMode_NightObserving;
        case 'S':
            return Astro_ThermalMode_SafeStowed;
        case 'U':
            return Astro_ThermalMode_Undefined;
    }
    return Astro_ThermalMode_Undefined;
}

inline Astro_SchedulerStage astroDecodeSchedulerStage(const AstroString &schedulerStageStr)
{
    switch (schedulerStageStr.length() > 2 ? schedulerStageStr[2] : '\0') {
        case 'd':
            return Astro_SchedulerStage_Undefined;
        case 'e':
            return Astro_SchedulerStage_Slewing;
        case 'f':
            return Astro_SchedulerStage_SafeStowed;
        case 'o':
            switch (schedulerStageStr.length() > 0 ? schedulerStageStr[0] : '\0') {
                case 'C':
                    return Astro_SchedulerStage_Cooling;
                case 'S':
                    return Astro_SchedulerStage_Stowing;
            }
            return Astro_SchedulerStage_Undefined;
        case 'p':
            return Astro_SchedulerStage_Deploying;
        case 'r':
            return Astro_SchedulerStage_Warming;
        case 's':
            return Astro_SchedulerStage_Observing;
        case 't':
            return Astro_SchedulerStage_Settling;
        case 'u':
            switch (schedulerStageStr.length() > 0 ? schedulerStageStr[0] : '\0') {
                case 'C':
                    return Astro_SchedulerStage_Count;
                case 'F':
                    return Astro_SchedulerStage_Fault;
            }
            return Astro_SchedulerStage_Undefined;
        case 'y':
            return Astro_SchedulerStage_DayStowed;
    }
    return Astro_SchedulerStage_Undefined;
}

#endif // /ifndef AstroEnumTrie_H
